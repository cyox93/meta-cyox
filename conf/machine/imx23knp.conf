## conf/machine/imx23knp.conf
```bitbake
#@TYPE: Machine
#@NAME: i.MX233 knp project
#@DESCRIPTION: Machine configuration for Freescale i.MX23 knp project

include conf/machine/include/mxs-base.inc

IMXBOOTLETS_MACHINE = "stmp378x_dev"

KERNEL_IMAGETYPE = "zImage"

IMAGE_BOOTLOADER = "imx-bootlets"

IMAGE_FSTYPES ?= "tar.bz2 jffs2 linux.sb"

MACHINE_FEATURES = "usbgadget alsa touchscreen"
```
